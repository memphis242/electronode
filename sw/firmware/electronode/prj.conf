## CMakeLists.txt
```
cmake_minimum_required(VERSION 3.20.0)

find_package(Zephyr REQUIRED HINTS $ENV{ZEPHYR_BASE})
project(electronode LANGUAGES C CXX) # C++20 will the app code's language

# I'm avoiding set(CMAKE_CXX_STANDARD 20) and set(CMAKE_CXX_STANDARD_REQUIRED ON)
# because it seems like in Zephyr, the preferred way of setting the C++ language
# is Kconfig (i.e., prj.conf):
#   CONFIG_CPP=y
#   CONFIG_STD_CPP20=y
# That lets Zephyr’s build system select the correct compiler flags consistently
# with the toolchain, board, and SDK, and shall remain the single source-of-truth.

target_include_directories(app PRIVATE include)

target_sources(app PRIVATE
  src/main.cpp
  src/acq/emg_adc.cpp
  src/acq/imu.cpp
  src/proc/emg.cpp
  src/proc/imu.cpp
  src/comm/ble.cpp
  src/sys/supervisor.cpp
)
```

## prj.conf
```kconfig
# Kernel services - I'm just going to guess initial sizes roughly
CONFIG_MAIN_STACK_SIZE=2048
CONFIG_SYSTEM_WORKQUEUE_STACK_SIZE=2048
CONFIG_HEAP_MEM_POOL_SIZE=1024

# Application language
CONFIG_CPP=y
CONFIG_STD_CPP20=y

# Hardware interfaces for Phase 1
CONFIG_ADC=y
# TODO: Depending on IMU selection, we will only enable SPI or I2C, not both
CONFIG_I2C=y
CONFIG_SPI=y
CONFIG_SENSOR=y

# Bluetooth
# note: the exact GATT service and payload layout are still TBD
CONFIG_BT=y
CONFIG_BT_PERIPHERAL=y
CONFIG_BT_DEVICE_NAME="electronode"

# Logs FTW
CONFIG_LOG=y
CONFIG_LOG_DEFAULT_LEVEL=4
```

## boards/bgm220_ek4314a.overlay
```dts
/*
 * Phase 1 board overlay placeholder.
 *
 * Add the MyoWare ADC input and IMU I2C/SPI wiring here once the Explorer Kit
 * pins are chosen. Keeping pin choices out of C code lets the same app move to
 * custom hardware later with a different board overlay.
 */
```

## src/main.cpp
```c
/**
 * @file main.cpp
 * @brief Provides the Zephyr application entry point and starts the supervisor.
 * @author Abdulla Almosalami @memphis242
 * @date 2026-04-26
 */

/* C++ standard header includes. */

/* Zephyr header includes. */
#include <zephyr/kernel.h>
#include <zephyr/logging/log.h>

/* Local header includes. */
#include <electronode/supervisor.hpp>

/* Local declarations. */

/** @brief Logging module for the application entry point. */
LOG_MODULE_REGISTER( electronode_main );

/* Public function/class/struct implementation. */

int main(void)
{
   LOG_INF( "electronode firmware starting" );

   return electronode::supervisor::start();
}

/* Local implementations. */
```
